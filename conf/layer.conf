## conf/layer.conf
```bitbake
# Append conf dir to BBPATH
BBPATH .= ":${LAYERDIR}"

# Append recipe dir to BBFILES
BBFILES += "${LAYERDIR}/recipes*/*/*.bb ${LAYERDIR}/recipes*/*/*.bbappend"

BBFILE_COLLECTIONS += "meta-vscode"
BBFILE_PATTERN_meta-vscode = "^${LAYERDIR}/"
BBFILE_PRIORITY_meta-vscode = "1"

LAYERDEPENDS_meta-vscode = "core"
LAYERVERSION_meta-vscode = "1"
LAYERSERIES_COMPAT_meta-vscode = "kirkstone scarthgap styhead walnascar whinlatter wrynose"
```
